## config/Kconfig
```kconfig
config ZMK_BEHAVIOR_CAPS_WORD_DE
    bool "Enable caps word DE behavior"
    default n
    help
      Enable the German caps word behavior that handles umlauts.
```

## config/caps-word-de-module/Kconfig
```kconfig
config ZMK_BEHAVIOR_CAPS_WORD_DE
    bool "Enable caps_word_de behavior"
    default y
```

## config/caps-word-de-module/dts/bindings/behaviors/zmk,behavior-caps-word-de.yaml
```yaml
description: |
  German caps_word behavior that capitalizes umlauts

compatible: "zmk,behavior-caps-word-de"

include: one-param-behavior.yaml

properties:
  label:
    type: string
    required: true
  continue-list:
    type: array
    default: []
```

## config/dts/bindings/behaviors/zmk,behavior-caps-word-de.yaml
```yaml
description: |
  German caps_word behavior that capitalizes umlauts

compatible: "zmk,behavior-caps-word-de"

include: zero_param.yaml

properties:
  "#binding-cells":
    type: int
    const: 0
  continue-list:
    type: array
```

## config/west.yml
```yaml
manifest:
  remotes:
    - name: zmkfirmware
      url-base: https://github.com/zmkfirmware

    # Additional modules containing boards/shields/custom code can be listed here as well.
    # See:
    # - https://zmk.dev/docs/features/modules
    # - https://docs.zephyrproject.org/3.5.0/develop/west/manifest.html#projects

    # https://github.com/urob/zmk-leader-key
    - name: urob
      url-base: https://github.com/urob
    - name: robertwidfen
      url-base: https://github.com/robertwidfen
  projects:
    - name: eyelash_corne
      url: https://github.com/a741725193/zmk-new_corne
      revision: main
    - name: zmk
      remote: zmkfirmware
      revision: v0.3
      import: app/west.yml
    - name: zmk-leader-key
      remote: urob
      revision: v0.3 # set to same as ZMK version above
    - name: zmk-helpers
      remote: urob
      revision: main
    - name: zmk-module-caps-word-de
      remote: robertwidfen
      revision: main
    #   revision: v0.3 # set to same as ZMK version above

  self:
    path: config
```
